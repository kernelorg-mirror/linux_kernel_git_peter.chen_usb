## Documentation/devicetree/bindings/power/pwrseq/pwrseq-usb-generic.txt
```
The power sequence for generic USB Devices

Some hard-wired USB devices need to do power sequence to let the
device work normally, the typical power sequence like: enable USB
PHY clock, toggle reset pin, etc. But current Linux USB driver
lacks of such code to do it, it may cause some hard-wired USB devices
works abnormal or can't be recognized by controller at all. The
power sequence will be done before this device can be found at USB
bus.

Required properties:
- compatible : contains "usb-pwrseq-generic".

Optional properties:
- clocks: the input clock for USB device.
- clock-frequency: the frequency for device's clock.
- reset-gpios: Should specify the GPIO for reset.
- reset-duration-us: the duration in microsecond for assert reset signal.
- enable-gpios: Should specify the GPIO for enable.
- power-supply: The regulator of the power

Example:

usb2415_pwrseq: usb2415_pwrseq {
	compatible = "usb-pwrseq-generic";
	clocks = <&clks IMX6QDL_CLK_CKO>;
	reset-gpios = <&gpio7 12 GPIO_ACTIVE_LOW>;
	reset-duration-us = <3000>;
	enable-gpios = <&gpio7 11 GPIO_ACTIVE_LOW>;
	power-supply = <&reg_usb_power>;
};
```

## drivers/power/pwrseq/Kconfig
```kconfig
menuconfig POWER_SEQ
	default y if OF
	bool "Hardware reset support for specific devices"
	help
	  Provides drivers that implements specific power sequences for chips,
	  using the generic power sequence management interface.

if POWER_SEQ

config POWER_SEQ_EMMC
	tristate "HW reset support for eMMC"
	default y
	depends on OF || COMPILE_TEST
	help
	  This selects Hardware reset support aka pwrseq-emmc for eMMC
	  devices. By default this option is set to y.

	  This driver can also be built as a module. If so, the module
	  will be called pwrseq_emmc.

config POWER_SEQ_SIMPLE
	tristate "Simple HW reset support for MMC"
	default y
	depends on OF || COMPILE_TEST
	help
	  This selects simple hardware reset support aka pwrseq-simple for MMC
	  devices. By default this option is set to y.

	  This driver can also be built as a module. If so, the module
	  will be called pwrseq_simple.

config POWER_SEQ_USB_GENERIC
	tristate "Generic power sequence support for USB devices"
	default y
	depends on OF || COMPILE_TEST
	help
	  This selects generic power sequence support for USB devices.
	  By default this option is set to y.

	  This driver can also be built as a module. If so, the module
	  will be called pwrseq_usb_generic.

endif
```
